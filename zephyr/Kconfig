## zephyr/Kconfig
```kconfig
# Copyright 2022, Victor Chavez
# SPDX-License-Identifier: GPL-3.0-or-later

config PHYPHOX_BLE
    bool "Phyphox BLE"
    default n
    help
        Enables the Phyphox BLE Module
        
if PHYPHOX_BLE

module = PHYPHOX_BLE
module-str = phyphox_ble

endif
```
