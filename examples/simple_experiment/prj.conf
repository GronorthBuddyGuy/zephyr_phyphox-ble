## CMakeLists.txt
```
# Copyright 2022, Victor Chavez
# SPDX-License-Identifier: GPL-3.0-or-later

cmake_minimum_required(VERSION 3.20.0)

# Path were experiment is located
set(PHYPHOX_EXP  ${CMAKE_CURRENT_SOURCE_DIR}/experiment.phyphox CACHE STRING INTERNAL)
set(PHYPHOX_BLE_ROOT ${CMAKE_CURRENT_SOURCE_DIR}/../..)

# Add the pyphoxble repo as a module for its use with zephyr
set(ZEPHYR_EXTRA_MODULES ${PHYPHOX_BLE_ROOT})

find_package(Zephyr REQUIRED HINTS $ENV{ZEPHYR_BASE})
project(simple_phyphox_experiment)
target_sources(app PRIVATE src/main.cpp
                            src/demo_service.cpp
                )
```

## prj.conf
```kconfig
# Dependencies
CONFIG_CPLUSPLUS=y
CONFIG_STD_CPP17=y
CONFIG_ASSERT=y
CONFIG_PHYPHOX_BLE=y

# Bluetooth
CONFIG_BT=y
CONFIG_BT_DEVICE_APPEARANCE=128
CONFIG_BT_DEVICE_NAME_DYNAMIC=y
CONFIG_BT_PERIPHERAL=y
#Increas MTU size for correct usage of phyphox ble service
CONFIG_BT_GATT_CLIENT=y
CONFIG_BT_BUF_ACL_RX_SIZE=251
CONFIG_BT_ATT_PREPARE_COUNT=2
CONFIG_BT_L2CAP_TX_MTU=247
CONFIG_BT_CTLR_PHY_2M=y
CONFIG_BT_CTLR_RX_BUFFERS=2
CONFIG_BT_BUF_ACL_TX_COUNT=10
CONFIG_BT_BUF_ACL_TX_SIZE=251
CONFIG_BT_CTLR_DATA_LENGTH_MAX=251
```

## src/main.cpp
```c
/*!*****************************************************************
* Copyright 2022, Victor Chavez
* SPDX-License-Identifier: GPL-3.0-or-later
* @file main.cpp
* @author Victor Chavez (chavez-bermudez@fh-aachen.de)
* @date Nov 23, 2022
*
* @brief
* Demo application that shows a simple experiment integration with phyphox module
* @par Dependencies
* - language: C++17
* - OS: Zephyr
********************************************************************/
#include <phyphox_ble.hpp>
#include <zephyr/bluetooth/bluetooth.h>
#include <zephyr/bluetooth/conn.h>
#include <zephyr/bluetooth/gatt.h>
#include <zephyr/random/rand32.h>
#include <assert.h>
#include "demo_service.hpp"

static constexpr uint32_t loop_delay_ms{500};

static void onConnect(bt_conn *conn, uint8_t err);

/*! @brief Callbacks for bt connection.
*/
BT_CONN_CB_DEFINE(conn_callbacks) = {
	.connected = onConnect,
	.disconnected = nullptr,
    .le_param_req = nullptr,
    .le_param_updated = nullptr
};

namespace adv
{
static constexpr
bt_data data[] = 
{
    BT_DATA_BYTES(BT_DATA_FLAGS, (BT_LE_AD_GENERAL | BT_LE_AD_NO_BREDR)),
    BT_DATA_BYTES(BT_DATA_UUID128_ALL,
                    RAW_UUID_128(phyphox_ble::uuid::SERVICE)),
};

static constexpr
bt_le_adv_param params = BT_LE_ADV_PARAM_INIT(BT_LE_ADV_OPT_CONNECTABLE |
                                                BT_LE_ADV_OPT_USE_NAME,
                                                BT_GAP_PER_ADV_SLOW_INT_MIN,
                                                BT_GAP_PER_ADV_SLOW_INT_MAX,
                                                NULL);
void start()
{
    const int err = bt_le_adv_start(&params,
                        data,
                        ARRAY_SIZE(data),
                        nullptr,
                        0);
    __ASSERT(err==0,"Adv start failed %d",err);
}

} // namespace adv

void ble_init()
{
    int res{0U};
    do
    {
        res =  bt_enable(nullptr);
        if(res != 0)
        {
            break;
        }
        res =  bt_set_name("Zephyr Phyphox Demo");
        if(res != 0)
        {
            break;
        }
    } while(false);
    __ASSERT(res == 0,"Could not start BLE Peripheral");
}

/*!< Callback for when an MTU exchange is done*/
static void mtuexchange_cb(bt_conn *conn, uint8_t err,
		                    bt_gatt_exchange_params *params)
{
    static_cast<void>(conn);
    static_cast<void>(err);
    static_cast<void>(params);
    printk("MTU exchang done\n");
}


static void onConnect(bt_conn *conn, uint8_t err)
{
    if(err == 0)
    {
        static bt_gatt_exchange_params exchange_params
        {
            .func = mtuexchange_cb
        };
        /*<! MTU size increase to send correctly phyphox experiment*/
        const int mtu_req = bt_gatt_exchange_mtu(conn, &exchange_params);
        __ASSERT(mtu_req==0,"Could not set mtu exchange");
    }
}

int main()
{
    ble_init();
    adv::start();
    while(true)
    {
        demo_service::notify_uptime();
        const auto rand_val = sys_rand32_get();
        demo_service::notify_simple_value(rand_val);
        k_sleep(K_MSEC(loop_delay_ms));
    }
    return 0;
}
```

## src/demo_service.cpp
```c
/*!*****************************************************************
* Copyright 2022, Victor Chavez
* SPDX-License-Identifier: GPL-3.0-or-later
* @file demo_service.cpp
* @author Victor Chavez (chavez-bermudez@fh-aachen.de)
* @date Nov 23, 2022
*
* @par Dependencies
* - language: C++17
* - OS: Zephyr
********************************************************************/
#include <zephyr/bluetooth/gatt.h>
#include <zephyr/sys/util.h>
#include <uuid_utils.hpp>
#include "demo_service.hpp"

namespace demo_service
{
    static float uptime{0.0f};
    static uint32_t simple_val{0};
    namespace uuid
    {
        /*! Arbitriary UUID for demo service */
        static constexpr bt_uuid_128 BASE = BT_UUID_INIT_128(BT_UUID_128_ENCODE(0x12340000, 
                                                                    0x0000,
                                                                    0x0000,
                                                                    0x0000,
                                                                    0x1234567859AB));
        /*! Service UUID */
        static constexpr bt_uuid_128 SERVICE = ble::utils::uuid::derive_uuid(BASE,0x0001);
        /*! characteristic UUIDs */
        namespace charact
        {
            static constexpr bt_uuid_128 UPTIME= ble::utils::uuid::derive_uuid(BASE,0x0002);
            static constexpr bt_uuid_128 SIMPLE_VAL = ble::utils::uuid::derive_uuid(BASE,0x0003);
        }
    } // namespace uuid

    namespace attr_idx
    {
        constexpr uint8_t uptime{2U};
        constexpr uint8_t simple_val{4U};
    } // namespace attr_idx

    BT_GATT_SERVICE_DEFINE(demo_svc,
        BT_GATT_PRIMARY_SERVICE( (void *)&uuid::SERVICE), // idx 0
        BT_GATT_CHARACTERISTIC( (bt_uuid *)&uuid::charact::UPTIME,  // idx 1
                                BT_GATT_CHRC_NOTIFY,
                                BT_GATT_PERM_READ,
                                nullptr,
                                nullptr,
                                nullptr),
        BT_GATT_CCC(nullptr, // idx 2
                BT_GATT_PERM_READ | BT_GATT_PERM_WRITE), // cppcheck-suppress syntaxError
        BT_GATT_CHARACTERISTIC( (bt_uuid *)&uuid::charact::SIMPLE_VAL,  // idx 3
                                BT_GATT_CHRC_NOTIFY,
                                BT_GATT_PERM_READ,
                                nullptr,
                                nullptr,
                                nullptr),
        BT_GATT_CCC(nullptr, // idx 4
                BT_GATT_PERM_READ | BT_GATT_PERM_WRITE), // cppcheck-suppress syntaxError
    );

    void notify_uptime()
    {
        static constexpr float ms_to_s{1000.0f};
        const uint32_t uptime_ms =  k_uptime_get_32();
        uptime = static_cast<float>(uptime_ms)/ms_to_s;
        const int gatt_res = bt_gatt_notify(nullptr,
										&demo_svc.attrs[attr_idx::uptime],
										&uptime,
										sizeof(uptime));
        static_cast<void>(gatt_res);
    }

    void notify_simple_value(uint32_t value)
    {
        simple_val = value;
        const int gatt_res = bt_gatt_notify(nullptr,
										&demo_svc.attrs[attr_idx::simple_val],
										&simple_val,
										sizeof(simple_val));
        static_cast<void>(gatt_res);
    }
} // namespace demo_service
```

## src/demo_service.hpp
```c
/*!*****************************************************************
* Copyright 2022, Victor Chavez
* SPDX-License-Identifier: GPL-3.0-or-later
* @file demo_service.hpp
* @author Victor Chavez (chavez-bermudez@fh-aachen.de)
* @date Nov 23, 2022
*
* @brief
* Demo service that allows to notify ble data to phyphox experiment
* @par Dependencies
* - language: C++17
* - OS: Zephyr
********************************************************************/
#pragma once
#include <cstdint>

namespace demo_service
{
    /*!@brief BLE Notify zephyr uptime */
    void notify_uptime();
    /*!@brief BLE Notify a simple uint32_t value */
    void notify_simple_value(uint32_t value);
}
```
